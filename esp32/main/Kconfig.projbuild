## esp32/main/Kconfig.projbuild
```kconfig
menu "QDOS"

	config QDOS_SHELL_STACK_KB
		int "Shell task stack, in KB"
		default 224
		range 64 320
		help
			The shell and the interpreter run on this stack. It is internal
			RAM, not PSRAM, because the store is on flash and a task whose
			stack is in PSRAM cannot reach flash. Measured under QEMU, the
			shell takes 42 KB and each Quadrate call level about 1.25 KB
			more -- 165 KB at 99 levels -- so this and QDOS_CALL_DEPTH go up
			and down together.

	config QDOS_CALL_DEPTH
		int "Deepest Quadrate call nesting"
		default 100
		range 16 200
		help
			Past this, a call is refused with an error rather than running
			off the end of the stack. The Pi allows 256.

	config QDOS_SERIAL_STACK
		bool "Echo the stack on the serial console"
		default n
		help
			Every change to the top of the stack is logged, with how much of
			the shell's stack has been used so far. For bring-up before the
			panel is wired, and for running under QEMU without a window.

	config QDOS_LCD
		bool "Drive a panel"
		default y
		help
			Off for a board with nothing on the SPI pins.

	config QDOS_LCD_QEMU
		bool "The panel is QEMU's virtual display"
		depends on QDOS_LCD
		default n
		help
			Espressif's QEMU does not emulate the S3's general-purpose SPI,
			so the Sharp panel cannot be driven there. It has a virtual RGB
			display instead, shown in a window. This does nothing on a chip.

	menu "Display (Sharp LS027B7DH01)"
		depends on QDOS_LCD && !QDOS_LCD_QEMU
		config QDOS_LCD_SCLK
			int "SCLK GPIO"
			default 39
		config QDOS_LCD_MOSI
			int "MOSI (DI) GPIO"
			default 40
		config QDOS_LCD_CS
			int "CS GPIO (active high)"
			default 41
		config QDOS_LCD_DISP
			int "DISP GPIO, or -1 where the breakout's pull-up is left to it"
			default -1
		config QDOS_LCD_HZ
			int "SPI clock, Hz"
			default 2000000
			help
				The panel's ceiling is 2 MHz.
	endmenu

	menu "Keypad matrix"
		config QDOS_KEY_ROW_PINS
			string "Row GPIOs, top row first"
			default "8,9,10,11,12,13,14,15,16,17"
			help
				Ten rows, driven open-drain. Each is held low through deep
				sleep so a press can wake the machine.
		config QDOS_KEY_COL_PINS
			string "Column GPIOs, left column first"
			default "1,2,4,5,6,7"
			help
				Six columns, read with pull-ups. They must be RTC GPIOs
				(0 to 21 on the S3): they are what wakes the chip from deep
				sleep.
	endmenu

endmenu
```

## firmware/buildroot/Config.in
```kconfig
menu "QDOS"
	source "$BR2_EXTERNAL_QDOS_PATH/package/quadrate/Config.in"
	source "$BR2_EXTERNAL_QDOS_PATH/package/qdos/Config.in"
endmenu
```

## firmware/buildroot/package/qdos/Config.in
```kconfig
config BR2_PACKAGE_QDOS
	bool "qdos"
	select BR2_PACKAGE_QUADRATE
	depends on BR2_TOOLCHAIN_HAS_THREADS
	depends on BR2_INSTALL_LIBSTDCPP
	help
	  QDOS, a calculator operating system whose shell is the Quadrate
	  language.

	  https://github.com/quadrate-language/qdos

comment "qdos needs a toolchain with C++ and threads"
	depends on !BR2_INSTALL_LIBSTDCPP || !BR2_TOOLCHAIN_HAS_THREADS
```

## firmware/buildroot/package/quadrate/Config.in
```kconfig
config BR2_PACKAGE_QUADRATE
	bool "quadrate"
	depends on BR2_TOOLCHAIN_HAS_THREADS
	depends on BR2_INSTALL_LIBSTDCPP
	help
	  The Quadrate language runtime, compiler front-end and AST
	  interpreter, built without LLVM. Provides the static libraries
	  QDOS links: libinterp, libqc, librt, libu8t
	  and the math and decimal modules.

	  https://github.com/quadrate-language/quadrate

comment "quadrate needs a toolchain with C++ and threads"
	depends on !BR2_INSTALL_LIBSTDCPP || !BR2_TOOLCHAIN_HAS_THREADS
```
